// HexagonSimulator Thu Sep 17 05:22:38 2015

 B::

 TOOLBAR ON
 STATUSBAR ON
 FramePOS -0.25 -0.071429 198. 71.
 WinPAGE.RESet

 WinPAGE.Create P000
 WinCLEAR

 WinPOS 0.375 19.357 73. 26. 0. 0. W001
 r /sl

 WinPOS 0.0 0.0 73. 15. 0. 0. W000
 area

 WinPOS 76.625 0.0 117. 44. 13. 1. W002
 WinTABS 16. 14. 25. 62.
 d.list

 WinPOS 0.0 50.429 100. 15. 0. 0. W003
 term.gate

 WinPAGE.select P000

 ENDDO
