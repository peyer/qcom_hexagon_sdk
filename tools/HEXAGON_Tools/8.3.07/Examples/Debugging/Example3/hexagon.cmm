;;;;;;;;;;;;;;;;;;;;;;;;;;;;;;;;;;;;;;;;;;;;;;;;;;;;;;;;;;;;;;;;;;;;;;;;;;;;;;;
; Startup Script for Trace32
;  1) Configure for "HexagonV60" processor
;  2) Start the simulator and T32 is attached to it
;;;;;;;;;;;;;;;;;;;;;;;;;;;;;;;;;;;;;;;;;;;;;;;;;;;;;;;;;;;;;;;;;;;;;;;;;;;;;;;


; Input argument = Hexagon ELF file that is simulated
entry &program_name &cpu_arch


; Setup layout of different windows within T32
do Layout.cmm


; Select a CPU
system.CPU HexagonV60
; Configure the options for Hexagon simulator before starting
system.mcdconfig arch=&cpu_arch simargs=--timing_nodbc &program_name
; Start the simulator and T32 is attached to it
system.mode attach


; load the ELF file symbols
data.load.elf &program_name /nocode /noclear /nomap


; set break point at main()
break.set main
break.set 0x5104
mode.mix
go


; End the cmm script
end
